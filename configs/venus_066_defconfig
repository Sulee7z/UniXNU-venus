## configs/venus_defconfig
```kconfig
# OS profile supplies the matching Apple ABI; hardware remains single-core.
CONFIG_XNU_SOURCE_CORECRYPTO14=y
CONFIG_XNU_SOURCE_PTHREAD=y
CONFIG_XNU_ARM_DT_PLATFORM=y
CONFIG_XNU_ARMCPU=y
CONFIG_XNU_CRYPTO_BOOTSTRAP="prelinked"
# CONFIG_XNU_ARMVIRT_PLATFORM is not set
# CONFIG_XNU_NATIVE_UFS is not set
# CONFIG_XNU_NATIVE_ADRENO is not set
# CONFIG_XNU_NATIVE_LEGACY_DISPLAY is not set
# CONFIG_XNU_NATIVE_RAM_BLOCK is not set
# CONFIG_XNU_NATIVE_VIRTIO_BLOCK is not set
# CONFIG_XNU_BOOT_PROGRESS is not set
CONFIG_XNU_SHENG_PMGR=y
```

## configs/venus_ufs_root_defconfig
```kconfig
# Verified unixnu root: real owner policies, APFS root and persistent Data.
CONFIG_XNU_BUILD_ARCHIVES=y
CONFIG_XNU_SOURCE_CORECRYPTO14=y
CONFIG_XNU_SOURCE_PTHREAD=y
CONFIG_XNU_ARM_DT_PLATFORM=y
CONFIG_XNU_ARMCPU=y
CONFIG_XNU_CRYPTO_BOOTSTRAP="prelinked"
CONFIG_XNU_NATIVE_UFS=y
CONFIG_XNU_VENUS_UFS_ROOT=y
CONFIG_XNU_NATIVE_VIRTIO_BLOCK=y
CONFIG_XNU_NATIVE_RAM_BLOCK=y
CONFIG_XNU_VERIFIED_ROOT_PROBE=y
CONFIG_XNU_OWNER_ROOT_AUDIT=y
CONFIG_XNU_OWNER_ROOT_TRUST=y
CONFIG_XNU_OWNER_CACHE_MOUNT=y
CONFIG_XNU_OWNER_CACHE_STARTUP=y
CONFIG_XNU_OWNER_BOOT_MANIFEST=y
CONFIG_XNU_OWNER_DATA_MOUNT=y
CONFIG_XNU_OWNER_UNION_SYSTEMOS=y
CONFIG_XNU_OWNER_DATA_VOLUME_UUID="FCC1EC83-9500-4D4D-AEED-6004A520B3C0"
CONFIG_XNU_OWNER_CACHE_VOLUME_UUID="8846FE78-2910-4297-AF97-D59BB6F8FC16"
CONFIG_XNU_NATIVE_VIRTIO_BLOCK_ARCHIVE="{tree}/build/virtio-mmio-block/libVirtioMmioBlock.a"
CONFIG_XNU_VERIFIED_ROOT_ARCHIVE="{tree}/build/verified-root-xnu/libVerifiedRootProbe.a"
# CONFIG_XNU_ARMVIRT_PLATFORM is not set
# CONFIG_XNU_NATIVE_ADRENO is not set
CONFIG_XNU_NATIVE_LEGACY_DISPLAY=y
# CONFIG_XNU_NATIVE_MOBILE_DISPLAY is not set
CONFIG_XNU_EXTRA_LD_ARCHIVES="{tree}/build/venus-a660/libVenusA660.a {tree}/build/native-legacy-display/libNativeLegacyDisplay.late.a"
CONFIG_XNU_BOOT_PROGRESS=y
CONFIG_XNU_SHENG_PMGR=y
```
